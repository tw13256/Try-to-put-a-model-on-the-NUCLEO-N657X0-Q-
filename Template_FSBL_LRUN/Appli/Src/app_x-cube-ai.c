
/**
 ******************************************************************************
 * @file    app_x-cube-ai.c
 * @author  X-CUBE-AI C code generator
 * @brief   AI program body
 ******************************************************************************
 * @attention
 *
 * Copyright (c) 2026 STMicroelectronics.
 * All rights reserved.
 *
 * This software is licensed under terms that can be found in the LICENSE file
 * in the root directory of this software component.
 * If no LICENSE file comes with this software, it is provided AS-IS.
 *
 ******************************************************************************
 */

/*
 * Description
 *   v1.0 - Minimum template to show how to use the Neural ART Embedded Client API
 *          Re-target of the printf function is out-of-scope.
 *
 *   For more information, see the embeded documentation:
 *
 *       [1] %X_CUBE_AI_DIR%/Documentation/index.html
 *
 *   X_CUBE_AI_DIR indicates the location where the X-CUBE-AI pack is installed
 *   typical : C:\Users\[user_name]\STM32Cube\Repository\STMicroelectronics\X-CUBE-AI\7.1.0
 */

#ifdef __cplusplus
extern "C" {
#endif

/* Includes ------------------------------------------------------------------*/

/* System headers */
#include <stdint.h>
#include <stdlib.h>
#include <stdio.h>
#include <inttypes.h>
#include <string.h>

#include "app_x-cube-ai.h"
#include "main.h"

/* USER CODE BEGIN includes */
/* USER CODE END includes */

/* Entry points --------------------------------------------------------------*/
const int8_t TEST_DATA_NORMAL[250] = {
		-14, -14, -15, -15, -15, -15, -15, -14, -15, -15, -14, -14,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 -14
};
const int8_t TEST_DATA_ABNORMAL[250] = {
		-10, -9, -8, -9, -8, -8, -7, -5, -4, -3, -3, -2,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 -23
};

#define TEST_DATA_LEN 20
#define WAVE_LEN 250

// 混合測試數據 (Mixed Quantized Data)
// Quantization Params: Scale = 0.019235..., ZeroPoint = -1
const int8_t TEST_DATA_MIXED[TEST_DATA_LEN][WAVE_LEN] = {
		{ -16, -15, -16, -16, -15, -16, -16, -17, -16, -17, -17, -16, -16,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 -9, -10 }, // Label: Normal (Idx: 2582)
		{ -32, -32, -32, -32, -31, -31, -32, -32, -33, -33, -33, -31, -31,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 18, 20 }, // Label: Normal (Idx: 7494)
		{ -20, -20, -20, -18, -18, -18, -18, -19, -18, -18, -17, -16, -17,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 -12, -13 }, // Label: Abnormal (Idx: 3068)
		{ -38, -38, -38, -38, -37, -37, -37, -37, -37, -36, -37, -36, -37,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 -26, -26 }, // Label: Normal (Idx: 7949)
		{ 2, 1, 0, -2, -3, -4, -5, -6, -6, -7, -8, -10, -10,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 -9, -10 }, // Label: Normal (Idx: 7437)
		{ -18, -19, -20, -20, -19, -18, -18, -19, -20, -20, -20, -20, -20,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 -11, -12 }, // Label: Abnormal (Idx: 7772)
		{ -21, -21, -23, -24, -26, -26, -24, -21, -20, -20, -21, -21, -19,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 -22, -21 }, // Label: Normal (Idx: 9024)
		{ 14, 14, 14, 12, 11, 9, 9, 8, 8, 7, 6, 4, 2,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 -9, -9 }, // Label: Normal (Idx: 6125)
		{ 25, 25, 24, 24, 23, 23, 23, 23, 22, 21, 19, 19, 19,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 -22, -23 }, // Label: Abnormal (Idx: 9610)
		{ -6, -6, -6, -6, -6, -7, -7, -6, -7, -7, -7, -7, -6,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 -9, -9 }, // Label: Abnormal (Idx: 5452)
		{ -10, -12, -15, -16, -17, -18, -17, -16, -17, -16, -16, -17, -17,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 23, 21 }, // Label: Abnormal (Idx: 8651)
		{ -30, -28, -27, -27, -27, -26, -26, -24, -23, -21, -20, -20, -20,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 8, 8 }, // Label: Abnormal (Idx: 4274)
		{ -3, -3, -3, -4, -4, -5, -5, -5, -5, -5, -6, -7, -8,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 8, 7 }, // Label: Abnormal (Idx: 7986)
		{ -5, -4, -6, -7, -7, -7, -6, -5, -4, -4, -5, -6, -8,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 0, 0 }, // Label: Abnormal (Idx: 7618)
		{ -12, -13, -13, -13, -13, -13, -13, -13, -13, -13, -13, -12, -12,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 -6, -5 }, // Label: Abnormal (Idx: 7554)
		{ -36, -37, -36, -35, -37, -36, -37, -37, -37, -37, -37, -37, -37,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 -7, -9 }, // Label: Normal (Idx: 5788)
		{ -17, -17, -18, -18, -19, -20, -20, -20, -19, -20, -19, -19, -19,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 -52, -50 }, // Label: Normal (Idx: 1073)
		{ 0, -1, -2, -2, -2, -1, -1, 0, 0, -2, 0, -1, 0,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 -2, -3 }, // Label: Abnormal (Idx: 2032)
		{ -45, -46, -46, -46, -46, -44, -44, -43, -43, -43, -43, -44, -44,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 -39, -39 }, // Label: Normal (Idx: 6612)
		{ -7, -7, -8, -7, -7, -7, -7, -7, -8, -8, -8, -8, -7,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 -4, -4 }, // Label: Normal (Idx: 670)
};

LL_ATON_DECLARE_NAMED_NN_INSTANCE_AND_INTERFACE(Default)
uint8_t *buffer_in;
uint8_t *buffer_out;

void set_clk_sleep_mode(void)
{
	/* Leave clocks enabled in Low Power modes */
	// Low-power clock enable misc
#if defined (CPU_IN_SECURE_STATE)
	__HAL_RCC_DBG_CLK_SLEEP_ENABLE();
#endif
	__HAL_RCC_XSPIPHYCOMP_CLK_SLEEP_ENABLE();

	// Low-power clock enable for memories
	__HAL_RCC_AXISRAM1_MEM_CLK_SLEEP_ENABLE();
	__HAL_RCC_AXISRAM2_MEM_CLK_SLEEP_ENABLE();
	__HAL_RCC_AXISRAM3_MEM_CLK_SLEEP_ENABLE();
	__HAL_RCC_AXISRAM4_MEM_CLK_SLEEP_ENABLE();
	__HAL_RCC_AXISRAM5_MEM_CLK_SLEEP_ENABLE();
	__HAL_RCC_AXISRAM6_MEM_CLK_SLEEP_ENABLE();
	__HAL_RCC_FLEXRAM_MEM_CLK_SLEEP_ENABLE();
	__HAL_RCC_CACHEAXIRAM_MEM_CLK_SLEEP_ENABLE();
	// LP clock AHB1: None
	// LP clock AHB2: None
	// LP clock AHB3
#if defined (CPU_IN_SECURE_STATE)
	__HAL_RCC_RIFSC_CLK_SLEEP_ENABLE();
	__HAL_RCC_RISAF_CLK_SLEEP_ENABLE();
	__HAL_RCC_IAC_CLK_SLEEP_ENABLE();
#endif
	// LP clock AHB4: None
	// LP clocks AHB5
	__HAL_RCC_XSPI1_CLK_SLEEP_ENABLE();
	__HAL_RCC_XSPI2_CLK_SLEEP_ENABLE();
	__HAL_RCC_CACHEAXI_CLK_SLEEP_ENABLE();
	__HAL_RCC_NPU_CLK_SLEEP_ENABLE();
	// LP clocks APB1: None
	// LP clocks APB2
	__HAL_RCC_USART1_CLK_SLEEP_ENABLE();
	// LP clocks APB4: None
	// LP clocks APB5: None
}

void MX_X_CUBE_AI_Init(void)
{
	__HAL_RCC_AXISRAM2_MEM_CLK_ENABLE();
	__HAL_RCC_AXISRAM3_MEM_CLK_ENABLE();
	__HAL_RCC_AXISRAM4_MEM_CLK_ENABLE();
	__HAL_RCC_AXISRAM5_MEM_CLK_ENABLE();
	__HAL_RCC_AXISRAM6_MEM_CLK_ENABLE();
	RAMCFG_SRAM2_AXI->CR &= ~RAMCFG_CR_SRAMSD;
	RAMCFG_SRAM3_AXI->CR &= ~RAMCFG_CR_SRAMSD;
	RAMCFG_SRAM4_AXI->CR &= ~RAMCFG_CR_SRAMSD;
	RAMCFG_SRAM5_AXI->CR &= ~RAMCFG_CR_SRAMSD;
	RAMCFG_SRAM6_AXI->CR &= ~RAMCFG_CR_SRAMSD;
	set_clk_sleep_mode();
	__HAL_RCC_NPU_CLK_ENABLE();
	__HAL_RCC_NPU_FORCE_RESET();
	__HAL_RCC_NPU_RELEASE_RESET();
	npu_cache_init();
	/* USER CODE BEGIN 5 */
	/* USER CODE END 5 */
}
//
//void MX_X_CUBE_AI_Process(void)
//{
//    /* USER CODE BEGIN 6 */
//  LL_ATON_RT_RetValues_t ll_aton_rt_ret = LL_ATON_RT_DONE;
//  const LL_Buffer_InfoTypeDef * ibuffersInfos = NN_Interface_Default.input_buffers_info();
//  const LL_Buffer_InfoTypeDef * obuffersInfos = NN_Interface_Default.output_buffers_info();
//  buffer_in = (uint8_t *)LL_Buffer_addr_start(&ibuffersInfos[0]);
//  buffer_out = (uint8_t *)LL_Buffer_addr_start(&obuffersInfos[0]);
//  LL_ATON_RT_RuntimeInit();
//  // run 10 inferences
//  for (int inferenceNb = 0; inferenceNb<10; ++inferenceNb) {
//    /* ------------- */
//    /* - Inference - */
//    /* ------------- */
//    /* Pre-process and fill the input buffer */
//    //_pre_process(buffer_in);
//    /* Perform the inference */
//    LL_ATON_RT_Init_Network(&NN_Instance_Default);  // Initialize passed network instance object
//    do {
//      /* Execute first/next step */
//      ll_aton_rt_ret = LL_ATON_RT_RunEpochBlock(&NN_Instance_Default);
//      /* Wait for next event */
//      if (ll_aton_rt_ret == LL_ATON_RT_WFE) {
//        LL_ATON_OSAL_WFE();
//      }
//    } while (ll_aton_rt_ret != LL_ATON_RT_DONE);
//    /* Post-process the output buffer */
//    /* Invalidate the associated CPU cache region if requested */
//    //_post_process(buffer_out);
//    LL_ATON_RT_DeInit_Network(&NN_Instance_Default);
//    /* -------------------- */
//    /* - End of Inference - */
//    /* -------------------- */
//  }
//  LL_ATON_RT_RuntimeDeInit();
//    /* USER CODE END 6 */
//}
uint32_t buff_in_len = 0;
uint32_t buff_out_len = 0;


/* ============================================== */

// ... 下面接原本的 code ...
//void MX_X_CUBE_AI_Process(void)
//{
//    /* USER CODE BEGIN 6 */
//    LL_ATON_RT_RetValues_t ll_aton_rt_ret = LL_ATON_RT_DONE;
//
//    /* ======================================= */
//    /* 預備工作：取得 Buffer 資訊與位址      */
//    /* ======================================= */
//    const LL_Buffer_InfoTypeDef * ibuffersInfos = NN_Interface_Default.input_buffers_info();
//    const LL_Buffer_InfoTypeDef * obuffersInfos = NN_Interface_Default.output_buffers_info();
//
//    buffer_in = (uint8_t *)LL_Buffer_addr_start(&ibuffersInfos[0]);
//    buffer_out = (uint8_t *)LL_Buffer_addr_start(&obuffersInfos[0]);
//
//    buff_in_len = ibuffersInfos->offset_end - ibuffersInfos->offset_start;
//    buff_out_len = obuffersInfos->offset_end - obuffersInfos->offset_start;
//
//    LL_ATON_RT_RuntimeInit();
//
//    printf("\r\n=============================================\r\n");
//    printf("   STM32 NPU Debug Mode: Dual Hypothesis Test\r\n");
//    printf("=============================================\r\n");
//
//    /* ======================================= */
//    /* 測試一：權重位址內容驗證 (Sanity Check) */
//    /* 確認 NPU 要讀的物理位址真的有資料        */
//    /* ======================================= */
//    uint8_t *flash_addr = (uint8_t *)0x71000000;
//    printf("[Test 1] Checking Weight Flash at 0x71000000...\r\n");
//
//    // 簡單檢查前 8 個 Byte 是否全 0 或全 FF
//    int is_empty = 1;
//    printf("   Data: ");
//    for(int i=0; i<8; i++) {
//        printf("%02X ", flash_addr[i]);
//        if(flash_addr[i] != 0x00 && flash_addr[i] != 0xFF) is_empty = 0;
//    }
//    printf("\r\n");
//
//    if(is_empty) {
//        printf("   !!! FATAL: Flash content is empty/invalid! NPU will output garbage.\r\n");
//    } else {
//        printf("   >>> Flash content looks valid (Random Data).\r\n");
//    }
//    printf("---------------------------------------------\r\n");
//
//
//    /* ======================================= */
//    /* 測試二：暴力掃描測試 (Sweep Test)      */
//    /* 無視輸入格式，從 -128 掃到 127           */
//    /* 只要輸出有變化，就代表模型是活的！        */
//    /* ======================================= */
//    printf("[Test 2] Starting Input Sweep Test (-128 to 127)...\r\n");
//
//    // 定義掃描的數值，從 int8 最小值開始
//    int16_t sweep_val = -128;
//
//    // 執行 20 次推論，每次增加輸入數值
//    for (int step = 0; step <= 20; ++step) {
//
//        // 1. 填入測試數據 (全 Buffer 填一樣的值)
//        // 注意：這裡強制轉型為 uint8_t 填入，模擬記憶體中的原始數據
//        memset(buffer_in, (uint8_t)sweep_val, buff_in_len);
//
//        // 2. Cache 維護 (CPU -> RAM)
//        // 務必使用正確的長度參數
//        mcu_cache_clean_invalidate_range((uint32_t)buffer_in, (uint32_t)buff_in_len);
//        npu_cache_invalidate();
//
//        // 3. 清空輸出 Buffer & Cache (RAM -> CPU 預備)
//        memset(buffer_out, 0, buff_out_len);
//        mcu_cache_clean_invalidate_range((uint32_t)buffer_out, (uint32_t)buff_out_len);
//
//        // 4. 執行推論
//        LL_ATON_RT_Init_Network(&NN_Instance_Default);
//        do {
//            ll_aton_rt_ret = LL_ATON_RT_RunEpochBlock(&NN_Instance_Default);
//            if (ll_aton_rt_ret == LL_ATON_RT_WFE) {
//                LL_ATON_OSAL_WFE();
//            }
//        } while (ll_aton_rt_ret != LL_ATON_RT_DONE);
//
//        // 5. 檢查執行結果
//        if (ll_aton_rt_ret != LL_ATON_RT_DONE) {
//            printf("   Step %2d: Input=%4d -> Inference Failed!\r\n", step, sweep_val);
//        } else {
//            // Cache Invalidate (RAM -> CPU) 確保讀到最新結果
//            mcu_cache_clean_invalidate_range((uint32_t)buffer_out, (uint32_t)buff_out_len);
//
//            int8_t out0 = (int8_t)buffer_out[0];
//            int8_t out1 = (int8_t)buffer_out[1];
//
//            // 印出結果
//            printf("   Step %2d: Input=%4d -> Output Raw: [%4d, %4d]", step, sweep_val, out0, out1);
//
//            // 簡單判斷是否有變化 (不再是 127/-128)
//            if (out0 != 127 || out1 != -128) {
//                 printf(" <--- ALIVE! (數值變了)");
//            }
//            printf("\r\n");
//        }
//
//        LL_ATON_RT_DeInit_Network(&NN_Instance_Default);
//
//        // 準備下一次的數值 (每次加 13，可以快速掃過整個範圍)
//        sweep_val += 13;
//        if (sweep_val > 127) break;
//    }
//
//    printf("=============================================\r\n");
//    printf("   Test Finished. System Halted.\r\n");
//
//    // 測試結束，卡住程式方便看 Log
//    while(1);
//
//    LL_ATON_RT_RuntimeDeInit();
//    /* USER CODE END 6 */
//}
void Print_Security_Debug(void) {
	printf("\r\n--- [SECURITY DIAGNOSTIC] ---\r\n");

	/* 1. 檢查 CPU 當下狀態 */
	if (__get_IPSR() != 0) {
		printf("CPU Mode: Handler Mode (Interrupt)\r\n");
	} else {
		if (__get_CONTROL() & 1) {
			printf("CPU Mode: Unprivileged\r\n");
		} else {
			printf("CPU Mode: Privileged\r\n");
		}
	}

	/* 檢查是否為 Secure 狀態 (透過編譯器旗標或 SAU 存取測試) */
#if defined (__ARM_FEATURE_CMSE) && (__ARM_FEATURE_CMSE == 3)
	printf("CPU World: SECURE (TrustZone Enabled)\r\n");
#else
	printf("CPU World: NON-SECURE (Or Legacy)\r\n");
#endif

	/* 2. 檢查 SAU (記憶體地圖) 狀態 */
	if (SAU->CTRL & SAU_CTRL_ENABLE_Msk) {
		printf("SAU: ENABLED\r\n");
		if (SAU->CTRL & SAU_CTRL_ALLNS_Msk) {
			printf("SAU Default: ALL NON-SECURE (Dangerous!)\r\n");
		} else {
			printf("SAU Default: ALL SECURE (Good)\r\n");
		}

		/* 遍歷 Region 檢查 Flash (0x70...) 和 SRAM (0x34...) */
		for (int i = 0; i < SAU->TYPE; i++) {
			SAU->RNR = i;
			if (SAU->RLAR & SAU_RLAR_ENABLE_Msk) {
				uint32_t start = SAU->RBAR & SAU_RBAR_BADDR_Msk;
				uint32_t end = SAU->RLAR & SAU_RLAR_LADDR_Msk;
				int is_nsc = (SAU->RLAR & SAU_RLAR_NSC_Msk) ? 1 : 0;

				printf("  Region %d: 0x%08lX - 0x%08lX -> %s\r\n",
						i, start, end,
						is_nsc ? "Secure (Callable)" : "NON-SECURE");

				if (start <= 0x71000000 && end >= 0x71000000) {
					printf("    -> [ALERT] Flash (0x71...) is defined here!\r\n");
				}
				if (start <= 0x34000000 && end >= 0x34000000) {
					printf("    -> [ALERT] SRAM (0x34...) is defined here!\r\n");
				}
			}
		}
	} else {
		printf("SAU: DISABLED (Everything is Secure)\r\n");
	}

	/* 3. 檢查 RIF (NPU 權限) */
	/* 註：RIF 暫存器地址依型號而定，這裡讀取 RIFSC 設定 */
	/* 假設 RIFSC_RISC_PERIPH_NPU 的 Index 根據手冊通常在特定位置 */
	/* 這裡我們直接用 HAL 函式設定的結果來反推，或者嘗試讀取 */
	/* 最準確的是看上面的 CPU World 和 SAU 就足夠判斷衝突了 */

	printf("---------------------------\r\n");
}
//void MX_X_CUBE_AI_Process(void)
//{
//
//	/* USER CODE BEGIN 6 */
//	/* 定義一個狀態變數，用來檢查 NPU 是否跑完 */
//	LL_ATON_RT_RetValues_t ll_aton_rt_ret = LL_ATON_RT_DONE;
//
//	/* 1. 問路：取得輸入和輸出緩衝區的「說明書 (Info)」 */
//	/* 這些結構體裡包含：緩衝區的起始地址、大小、格式等 */
//	const LL_Buffer_InfoTypeDef * ibuffersInfos = NN_Interface_Default.input_buffers_info();
//	const LL_Buffer_InfoTypeDef * obuffersInfos = NN_Interface_Default.output_buffers_info();
//
//	/* 2. 定位：從說明書中算出「實際記憶體地址」 */
//	/* 這裡就是算出 0x34100000 這種實際地址給 buffer_in 指標 */
//	buffer_in = (uint8_t *)LL_Buffer_addr_start(&ibuffersInfos[0]);
//	buffer_out = (uint8_t *)LL_Buffer_addr_start(&obuffersInfos[0]);
//
//	/* 3. 印出除錯資訊 (驗證大小是否為 250 和 2) */
//	buff_in_len = ibuffersInfos->offset_end - ibuffersInfos->offset_start;
//	buff_out_len = obuffersInfos->offset_end - obuffersInfos->offset_start;
//
//	printf("Debug: Input Size = %lu (Expected: 250)\n\r", buff_in_len);
//	printf("Debug: Output Size = %lu (Expected: 2)\n\r", buff_out_len);
//
//	/* 新加: 初始化随机种子 (只一次，防止rand固定) */
//	static uint8_t srand_init = 0;  /* 静态变量，确保只init一次 */
//	if (!srand_init) {
//		srand(HAL_GetTick());  /* 用HAL tick作为种子，严谨避免time(NULL)需RTC */
//		srand_init = 1;
//	}
//
//	LL_ATON_RT_RuntimeInit();
//
//	printf("\r\n12\r\n");
//
//	Print_Security_Debug();
//	//    LL_ATON_RT_RuntimeInit();
//
//	printf("\r\n=============================================\r\n");
//	printf("   STM32 NPU Debug Mode: Dual Hypothesis Test\r\n");
//	printf("=============================================\r\n");
//
//	/* ======================================= */
//	/* 測試一：權重位址內容驗證 (Sanity Check) */
//	/* 確認 NPU 要讀的物理位址真的有資料        */
//	/* ======================================= */
//	uint8_t *flash_addr = (uint8_t *)0x71000000;
//	printf("[Test 1] Checking Weight Flash at 0x71000000...\r\n");
//
//	// 簡單檢查前 8 個 Byte 是否全 0 或全 FF
//	//	int is_empty = 1;
//	printf("   Data: ");
//	for(int i=0; i<8; i++) {
//		printf("%02X ", flash_addr[i]);
//		//		if(flash_addr[i] != 0x00 && flash_addr[i] != 0xFF) is_empty = 0;
//	}
//	printf("\r\n");
//
//	// run 10 inferences
//	//	for (int inferenceNb = 0; inferenceNb < 3; ++inferenceNb) {
//	//		/* ------------- */
//	//		/* - Inference - */
//	//		/* ------------- */
//	//		/* Pre-process and fill the input buffer */
//	//		// [新增] 6:4 機率選擇資料 (0~5=Normal, 6~9=Abnormal)
//	//		int random_val = rand() % 10;
//	//		const int8_t *p_source_data;
//	//
//	//		if (random_val < 6) {
//	//			printf("Source: NORMAL Data (Rand=%d, Target: 60%%)\r\n", random_val);
//	//			p_source_data = TEST_DATA_NORMAL;
//	//		} else {
//	//			printf("Source: ABNORMAL Data (Rand=%d, Target: 40%%)\r\n", random_val);
//	//			p_source_data = TEST_DATA_ABNORMAL;
//	//		}
//	for (int i = 0; i < TEST_DATA_LEN; i++) {
//
//		printf("\r\n--- [Sample #%d] ---\r\n", i);
//
//		// 1. 從 header 檔取得資料指標與正確答案
//		// TEST_DATA_MIXED 是二維陣列，[i] 就是第 i 筆波形的起始地址
//		const int8_t *p_source_data = TEST_DATA_MIXED[i];
//		//		uint8_t expected_label = TEST_LABELS_MIXED[i];
//
//		// 印出這筆資料的正確答案 (Ground Truth)
//		//		printf("Ground Truth: %s\r\n", (expected_label == 0) ? "NORMAL (0)" : "ABNORMAL (1)");
//
//		// 2. 填入 Input Buffer
//		// 因為 Python 已經生成 int8_t 量化資料，直接複製即可
//		for(uint32_t j = 0; j < buff_in_len; j++){
//			buffer_in[j] = (uint8_t)p_source_data[j];
//			printf("E:%d\r\n", (int8_t)buffer_in[i]);  /* cast回int8打印 */
//			// 如果想看詳細數據可以打開下面註解
//			// printf("%d,", p_source_data[j]);
//		}
//		// [模仿官方] Fill input buffer data
//		// 官方是用迴圈逐一填入，我們照做，把 val 改成 p_source_data[i]
//		//		for(uint32_t i = 0; i < buff_in_len; i++){
//		//			buffer_in[i] = (uint8_t)((int8_t)p_source_data[i]);  /* 显式cast int8_t到uint8_t，避免隐式警告 */
//		//			printf("E:%d\r\n", (int8_t)buffer_in[i]);  /* cast回int8打印 */
//		//		}
//
//
//
//
//		//_pre_process(buffer_in);
//
//		// 新加: 填输入后，clean cache到RAM (确保NPU读新)
//
//		//        mcu_cache_clean_invalidate_range((uint32_t)buffer_in, (uint32_t)buff_in_len);
//		mcu_cache_clean_invalidate_range((uint32_t)buffer_in, (uint32_t)(buffer_in + buff_in_len));  // clean: CPU -> RAM
//		//		mcu_cache_clean_invalidate_range((uint32_t)buffer_in, (uint32_t)buff_in_len);
//		// [模仿官方] invalidate NPU cache (清NPU缓存读新RAM)
//		npu_cache_invalidate();
//
//		// 新加: 初始化输出缓冲为0 (避免垃圾，确认NPU写)
//		//        memset(buffer_out, 0, buff_out_len);
//		////        mcu_cache_clean_invalidate_range((uint32_t)buffer_out, (uint32_t)buff_out_len);
//		//		        mcu_cache_clean_invalidate_range((uint32_t)buffer_out, (uint32_t)(buffer_out + buff_out_len));
//		//		memset(buffer_out, 0, buff_out_len);
//		//		mcu_cache_clean_invalidate_range((uint32_t)buffer_out, (uint32_t)buff_out_len);
//		// Check Input (印前10點確認完整，无溢出)
//
//		printf("LED0\n\r");
//		printf("Buffer[0~9] = %d,%d,%d,%d,%d,%d,%d,%d,%d,%d \n\r",
//				(int8_t)buffer_in[0], (int8_t)buffer_in[1], (int8_t)buffer_in[2], (int8_t)buffer_in[3],
//				(int8_t)buffer_in[4], (int8_t)buffer_in[5], (int8_t)buffer_in[6], (int8_t)buffer_in[7],
//				(int8_t)buffer_in[8], (int8_t)buffer_in[9]);
//
//		printf("LED1\n\r");
//		/* Perform the inference */
//		LL_ATON_RT_Init_Network(&NN_Instance_Default);  // Initialize passed network instance object
//		/* ... 在定義 raw_logits_addr 之後 ... */
//		uint32_t raw_logits_addr = 0x342E0100;
//
//		/* 【新增測試】先把輸出區填滿垃圾 (0x55) */
//		memset((void*)raw_logits_addr, 0x55, 32);
//		mcu_cache_clean_invalidate_range(raw_logits_addr, 32); // 把垃圾寫入 RAM
//		/***************************************************************************/
//		/***************************************************************************/
//		/***************************************************************************/
//		/***************************************************************************/
//		printf("LED2\n\r");
//		do {
//			/* Execute first/next step */
//			ll_aton_rt_ret = LL_ATON_RT_RunEpochBlock(&NN_Instance_Default);
//			/* Wait for next event */
//			if (ll_aton_rt_ret == LL_ATON_RT_WFE) {
//				LL_ATON_OSAL_WFE();
//			}
//		} while (ll_aton_rt_ret != LL_ATON_RT_DONE);
//		/***************************************************************************/
//		/***************************************************************************/
//		/***************************************************************************/
//		/***************************************************************************/
//
//		mcu_cache_clean_invalidate_range(raw_logits_addr, 32); // 讀回來
//		int8_t *p_raw = (int8_t *)raw_logits_addr;
//
//		printf("   [Debug Analysis]\r\n");
//		if (p_raw[0] == 0x55 && p_raw[1] == 0x55) {
//		    printf("   ❌ FATAL: NPU did NOT write to output! (Memory is still 0x55)\r\n");
//		} else {
//		    printf("   ├── Raw Logits: [%d, %d] (NPU wrote this!)\r\n", p_raw[0], p_raw[1]);
//		}
//		if (ll_aton_rt_ret != LL_ATON_RT_DONE) {
//			printf("Error: Inference failed, ret=%d\r\n", (int)ll_aton_rt_ret);
//		} else {
//			printf(">>> Inference Done. Checking Activations at 0x342E0000...\r\n");
//
//			/* 1. 定義 NPU 暫存區的絕對地址 (來自 network.c 的資訊) */
//			/* 這裡對應到 SRAM5 (AXISRAM5) */
//			uint32_t target_addr = 0x342E0000;
//			uint32_t check_size = 1024; // 檢查前 1KB 即可
//
//			/* 2. 【關鍵】刷新 Cache */
//			/* 告訴 CPU：這個地址的內容剛被 NPU 改過，請重新去 RAM 讀，不要信 Cache */
//			mcu_cache_clean_invalidate_range(target_addr, check_size);
//
//			/* 3. 印出前 64 個 Byte */
//			uint8_t *p_mem = (uint8_t *)target_addr;
//			int non_zero_count = 0;
//
//			printf("   [Memory Dump @ 0x%08X]:\r\n   ", (unsigned int)target_addr);
//			for(int k=0; k<64; k++) {
//				printf("%02X ", p_mem[k]);
//				if(p_mem[k] != 0) non_zero_count++;
//				if((k+1)%16==0) printf("\r\n   ");
//			}
//			printf("\r\n");
//
//			/* 4. 診斷 */
//			if(non_zero_count == 0) {
//				printf("   ⚠️ WARNING: Memory is ALL ZERO! (NPU didn't write anything)\r\n");
//				printf("      Likely Cause: SRAM5/6 Clock not enabled in RAMCFG.\r\n");
//			} else {
//				printf("   ✅ OK: Non-zero content found! NPU is working properly.\r\n");
//			}
//		}
//
//		/* 1. 定義地址 (根據 network.c 的分析) */
//		/* 這是 NPU 跑完 Epoch 5 後，留給 Epoch 6 (Softmax) 吃的輸入資料 */
//		uint32_t raw_logits_addr = 0x342E0100; // Offset 256
//		/* 這是 Epoch 6 (Softmax) 算完吐出來的最終結果 */
//		uint32_t final_prob_addr = 0x342E0110; // Offset 272
//		memset((void*)raw_logits_addr, 0x55, 32);
////		mcu_cache_clean_invalidate_range(raw_logits_addr, 32); // 把垃圾寫入 RAM
//		/* 2. 刷新 Cache (非常重要！) */
//		/* 因為 Raw Logits 是 NPU 寫的，CPU 要讀必須 Invalidate */
//		mcu_cache_clean_invalidate_range(raw_logits_addr, 32);
//		/* Final Prob 是 CPU 寫的 (SW Layer)，但為了保險起見也刷一下 */
//		mcu_cache_clean_invalidate_range(final_prob_addr, 32);
//
//		/* 3. 讀取數值 */
//		int8_t *p_raw = (int8_t *)raw_logits_addr;
//		int8_t *p_final = (int8_t *)final_prob_addr;
//
//		/* 4. 印出對比 (Debug View) */
//		printf("   [Debug Analysis]\r\n");
//		printf("   ├── Raw Logits (NPU Output):  [%d, %d]\r\n", p_raw[0], p_raw[1]);
//		printf("   └── Final Prob (SW Softmax):  [%d, %d]\r\n", p_final[0], p_final[1]);
//
//		/* 5. 診斷邏輯 */
//		int diff = p_raw[0] - p_raw[1];
//		if (diff == 0) {
//			printf("   ⚠️ ALERT: Raw Logits are Identical! Model can't decide.\r\n");
//		} else if (p_final[0] == 127 || p_final[1] == 127) {
//			printf("   ℹ️ NOTE: Softmax Saturated. (Raw Diff of %d is too large for int8 scale)\r\n", diff);
//		}
//
//		printf("LED3\n\r");
//		// 新加: 检查ret (确认全epochs跑完，包括SW softmax)
//		if (ll_aton_rt_ret != LL_ATON_RT_DONE) {
//			printf("Error: Inference failed, ret=%d\n\r", (int)ll_aton_rt_ret);  /* cast enum到int打印 */
//			continue;  /* 跳过坏推理 */
//		}
//
//		// invalidate output cache (从RAM拉到CPU)
//		//        mcu_cache_clean_invalidate_range((uint32_t)buffer_out, (uint32_t)buff_out_len);
//		mcu_cache_clean_invalidate_range((uint32_t)buffer_out, (uint32_t)(buffer_out + buff_out_len));  // invalidate: RAM -> CPU cache
//		// --- [修改開始] 直接讀取 index 0 和 1 並比較 ---
//		//		mcu_cache_clean_invalidate_range((uint32_t)buffer_out, (uint32_t)buff_out_len);
//		// 取得原始數據
//		int8_t raw_normal = (int8_t)buffer_out[0];
//		int8_t raw_abnormal = (int8_t)buffer_out[1];
//
//		// 轉換成機率 (僅用於人類閱讀 Debug，公式正確)
//		// 假設模型輸出範圍是對應 0.0 ~ 1.0
//		float prob_normal = ((float)raw_normal + 128.0f) / 255.0f * 100.0f;
//		float prob_abnormal = ((float)raw_abnormal + 128.0f) / 255.0f * 100.0f;
//
//		//                printf("Raw: [%d, %d] -> Prob: [%.1f%%, %.1f%%]\r\n",
//		//                       raw_normal, raw_abnormal, prob_normal, prob_abnormal);
//		printf("Raw: [%d, %d] -> Prob: [%d%%, %d%%]\r\n",
//				raw_normal, raw_abnormal, (int)prob_normal, (int)prob_abnormal);
//		// 直接比對原始數值 (最快且最準)
//		if (raw_normal > raw_abnormal) {
//			printf(">>> Prediction: NORMAL (正常)\r\n");
//		} else {
//			printf(">>> Prediction: ABNORMAL (異常)\r\n");
//		}
//
//
//
//		// 5. 分隔線 (讓 Log 好讀一點)
//		printf("--------------------------------------------------\r\n");
//
//		//_post_process(buffer_out);
//		LL_ATON_RT_DeInit_Network(&NN_Instance_Default);
//		/* -------------------- */
//		/* - End of Inference - */
//		/* -------------------- */
//	}
//
//
//
//
//
//
//
//	// run 10 inferences
//	for (int inferenceNb = 0; inferenceNb < 3; ++inferenceNb) {
//		/* ------------- */
//		/* - Inference - */
//		/* ------------- */
//		/* Pre-process and fill the input buffer */
//		// [新增] 6:4 機率選擇資料 (0~5=Normal, 6~9=Abnormal)
//		int random_val = rand() % 10;
//		const int8_t *p_source_data;
//
//		if (random_val < 6) {
//			printf("Source: NORMAL Data (Rand=%d, Target: 60%%)\r\n", random_val);
//			p_source_data = TEST_DATA_NORMAL;
//		} else {
//			printf("Source: ABNORMAL Data (Rand=%d, Target: 40%%)\r\n", random_val);
//			p_source_data = TEST_DATA_ABNORMAL;
//		}
//
//		// [模仿官方] Fill input buffer data
//		// 官方是用迴圈逐一填入，我們照做，把 val 改成 p_source_data[i]
//		for(uint32_t i = 0; i < buff_in_len; i++){
//			buffer_in[i] = (uint8_t)((int8_t)p_source_data[i]);  /* 显式cast int8_t到uint8_t，避免隐式警告 */
//			printf("E:%d\r\n", (int8_t)buffer_in[i]);  /* cast回int8打印 */
//		}
//
//
//
//
//		//_pre_process(buffer_in);
//
//		// 新加: 填输入后，clean cache到RAM (确保NPU读新)
//
//		//        mcu_cache_clean_invalidate_range((uint32_t)buffer_in, (uint32_t)buff_in_len);
//		//			        mcu_cache_clean_invalidate_range((uint32_t)buffer_in, (uint32_t)(buffer_in + buff_in_len));  // clean: CPU -> RAM
//		mcu_cache_clean_invalidate_range((uint32_t)buffer_in, (uint32_t)buff_in_len);
//		// [模仿官方] invalidate NPU cache (清NPU缓存读新RAM)
//		npu_cache_invalidate();
//
//		// 新加: 初始化输出缓冲为0 (避免垃圾，确认NPU写)
//		//        memset(buffer_out, 0, buff_out_len);
//		////        mcu_cache_clean_invalidate_range((uint32_t)buffer_out, (uint32_t)buff_out_len);
//		//		        mcu_cache_clean_invalidate_range((uint32_t)buffer_out, (uint32_t)(buffer_out + buff_out_len));
//		//		memset(buffer_out, 0, buff_out_len);
//		//		mcu_cache_clean_invalidate_range((uint32_t)buffer_out, (uint32_t)buff_out_len);
//		// Check Input (印前10點確認完整，无溢出)
//
//		printf("LED0\n\r");
//		printf("Buffer[0~9] = %d,%d,%d,%d,%d,%d,%d,%d,%d,%d \n\r",
//				(int8_t)buffer_in[0], (int8_t)buffer_in[1], (int8_t)buffer_in[2], (int8_t)buffer_in[3],
//				(int8_t)buffer_in[4], (int8_t)buffer_in[5], (int8_t)buffer_in[6], (int8_t)buffer_in[7],
//				(int8_t)buffer_in[8], (int8_t)buffer_in[9]);
//
//		printf("LED1\n\r");
//		/* Perform the inference */
//		LL_ATON_RT_Init_Network(&NN_Instance_Default);  // Initialize passed network instance object
//
//		printf("LED2\n\r");
//		do {
//			/* Execute first/next step */
//			ll_aton_rt_ret = LL_ATON_RT_RunEpochBlock(&NN_Instance_Default);
//			/* Wait for next event */
//			if (ll_aton_rt_ret == LL_ATON_RT_WFE) {
//				LL_ATON_OSAL_WFE();
//			}
//		} while (ll_aton_rt_ret != LL_ATON_RT_DONE);
//
//
//		///*/*************/*/*/*/*/*/*/*/*/*/*/*/*/*/*/*/*/*/*/*/*/*/*/*/*/*/*/*/*/*/*/*/*/*/*/*/*/*/*/*/*/*
//		///*/*************/*/*/*/*/*/*/*/*/*/*/*/*/*/*/*/*/*/*/*/*/*/*/*/*/*/*/*/*/*/*/*/*/*/*/*/*/*/*/*/*/*
//		///*/*************/*/*/*/*/*/*/*/*/*/*/*/*/*/*/*/*/*/*/*/*/*/*/*/*/*/*/*/*/*/*/*/*/*/*/*/*/*/*/*/*/*
//		///*/*************/*/*/*/*/*/*/*/*/*/*/*/*/*/*/*/*/*/*/*/*/*/*/*/*/*/*/*/*/*/*/*/*/*/*/*/*/*/*/*/*/*
//		///*/*************/*/*/*/*/*/*/*/*/*/*/*/*/*/*/*/*/*/*/*/*/*/*/*/*/*/*/*/*/*/*/*/*/*/*/*/*/*/*/*/*/*
/////*/*************/*/*/*/*/*/*/*/*/*/*/*/*/*/*/*/*/*/*/*/*/*/*/*/*/*/*/*/*/*/*/*/*/*/*/*/*/*/*/*/*/*
//		printf("LED3\n\r");
//		// 新加: 检查ret (确认全epochs跑完，包括SW softmax)
//		if (ll_aton_rt_ret != LL_ATON_RT_DONE) {
//			printf("Error: Inference failed, ret=%d\n\r", (int)ll_aton_rt_ret);  /* cast enum到int打印 */
//			continue;  /* 跳过坏推理 */
//		}
//
//		// invalidate output cache (从RAM拉到CPU)
//		mcu_cache_clean_invalidate_range((uint32_t)buffer_out, (uint32_t)buff_out_len);
//		//			        mcu_cache_clean_invalidate_range((uint32_t)buffer_out, (uint32_t)(buffer_out + buff_out_len));  // invalidate: RAM -> CPU cache
//		// --- [修改開始] 直接讀取 index 0 和 1 並比較 ---
//		//		mcu_cache_clean_invalidate_range((uint32_t)buffer_out, (uint32_t)buff_out_len);
//		// 取得原始數據
//		int8_t raw_normal = (int8_t)buffer_out[0];
//		int8_t raw_abnormal = (int8_t)buffer_out[1];
//
//		// 轉換成機率 (僅用於人類閱讀 Debug，公式正確)
//		// 假設模型輸出範圍是對應 0.0 ~ 1.0
//		float prob_normal = ((float)raw_normal + 128.0f) / 255.0f * 100.0f;
//		float prob_abnormal = ((float)raw_abnormal + 128.0f) / 255.0f * 100.0f;
//
//		//                printf("Raw: [%d, %d] -> Prob: [%.1f%%, %.1f%%]\r\n",
//		//                       raw_normal, raw_abnormal, prob_normal, prob_abnormal);
//		printf("Raw: [%d, %d] -> Prob: [%d%%, %d%%]\r\n",
//				raw_normal, raw_abnormal, (int)prob_normal, (int)prob_abnormal);
//		// 直接比對原始數值 (最快且最準)
//		if (raw_normal > raw_abnormal) {
//			printf(">>> Prediction: NORMAL (正常)\r\n");
//		} else {
//			printf(">>> Prediction: ABNORMAL (異常)\r\n");
//		}
//
//
//
//		// 5. 分隔線 (讓 Log 好讀一點)
//		printf("--------------------------------------------------\r\n");
//
//		//_post_process(buffer_out);
//		LL_ATON_RT_DeInit_Network(&NN_Instance_Default);
//		/* -------------------- */
//		/* - End of Inference - */
//		/* -------------------- */
//	}
//	LL_ATON_RT_RuntimeDeInit();
//	/* USER CODE END 6 */
//}

void MX_X_CUBE_AI_Process(void)
{
    /* USER CODE BEGIN 6 */

    /* ============================================================= */
    /* 1. 變數宣告區                                                 */
    /* ============================================================= */
    LL_ATON_RT_RetValues_t ll_aton_rt_ret = LL_ATON_RT_DONE;

    // 緩衝區資訊
    const LL_Buffer_InfoTypeDef * ibuffersInfos;
    const LL_Buffer_InfoTypeDef * obuffersInfos;

    // 除錯用的地址 (根據 network.c 分析)
    // 這些是各層輸出的 "目的地"
    uint32_t sram5_base      = 0x342E0000;
    uint32_t raw_logits_addr = 0x342E0100; // Epoch 5 Output

    // 迴圈與計數變數
    int i, j;

    /* ============================================================= */
    /* 2. 系統初始化                                                 */
    /* ============================================================= */
    ibuffersInfos = NN_Interface_Default.input_buffers_info();
    obuffersInfos = NN_Interface_Default.output_buffers_info();

    buffer_in  = (uint8_t *)LL_Buffer_addr_start(&ibuffersInfos[0]);
    buffer_out = (uint8_t *)LL_Buffer_addr_start(&obuffersInfos[0]);

    buff_in_len = ibuffersInfos->offset_end - ibuffersInfos->offset_start;
    buff_out_len = obuffersInfos->offset_end - obuffersInfos->offset_start;

    printf("Debug: Input Size = %lu (Expected: 250)\n\r", buff_in_len);
    printf("Debug: Output Size = %lu (Expected: 2)\n\r", buff_out_len);

    static uint8_t srand_init = 0;
    if (!srand_init) {
        srand(HAL_GetTick());
        srand_init = 1;
    }

    LL_ATON_RT_RuntimeInit();
    Print_Security_Debug();

    printf("\r\n=============================================\r\n");
    printf("   STM32 NPU Debug: Layer-by-Layer Inspection\r\n");
    printf("=============================================\r\n");

    /* [Test 1] Flash 檢查 */
    uint8_t *flash_addr = (uint8_t *)0x71000000;
    printf("[Test 1] Checking Flash Header at 0x71000000...\r\n");
    printf("   Data: ");
    for(i=0; i<8; i++) printf("%02X ", flash_addr[i]);
    printf("\r\n");

    /* ============================================================= */
    /* 3. 推論迴圈                                                   */
    /* ============================================================= */
    // 使用 TEST_DATA_LEN 跑完所有測試資料
    for (i = 0; i < TEST_DATA_LEN; i++) {

        printf("\r\n--- [Sample #%d] ---\r\n", i);

        /* --- Step A: 填入輸入數據 --- */
        const int8_t *p_source_data = TEST_DATA_MIXED[i];
        for(uint32_t idx = 0; idx < buff_in_len; idx++){
            buffer_in[idx] = (uint8_t)p_source_data[idx];
        }

        // 印出輸入前 10 點 (確認輸入不同)
        printf("Input[0~9]: %d,%d,%d,%d,%d,%d,%d,%d,%d,%d \n\r",
                (int8_t)buffer_in[0], (int8_t)buffer_in[1], (int8_t)buffer_in[2],
                (int8_t)buffer_in[3], (int8_t)buffer_in[4], (int8_t)buffer_in[5],
                (int8_t)buffer_in[6], (int8_t)buffer_in[7], (int8_t)buffer_in[8],
                (int8_t)buffer_in[9]);

        /* --- Step B: 預填垃圾 (0x55) 到最終輸出區 --- */
        memset((void*)raw_logits_addr, 0x55, 32);
        mcu_cache_clean_invalidate_range(raw_logits_addr, 32);

        /* --- Step C: Cache 維護 --- */
        mcu_cache_clean_invalidate_range((uint32_t)buffer_in, (uint32_t)buff_in_len);
        npu_cache_invalidate();

        /* --- Step D: 執行推論 (含中間層監控) --- */
        printf(">>> Start Inference (Step-by-Step)...\n\r");
        LL_ATON_RT_Init_Network(&NN_Instance_Default);

        int epoch_step = 0; // 用來記錄現在跑到第幾層了

        do {
            /* 執行一個 Epoch Block */
            ll_aton_rt_ret = LL_ATON_RT_RunEpochBlock(&NN_Instance_Default);

            if (ll_aton_rt_ret == LL_ATON_RT_WFE) {
                LL_ATON_OSAL_WFE();
            }

            /* === [新功能] 中間層產出檢查 === */
            /* 每次 NPU 跑完一塊，我們就偷看一下 SRAM */
            epoch_step++;

            uint32_t inspect_addr = 0;
            char *step_name = "Unknown";

            // 根據 network.c 的記憶體規劃對應地址
            switch(epoch_step) {
                case 1: // Epoch 2 結束 (Conv2D -> MaxPool)
                    inspect_addr = 0x342E0100; // offset 256
                    step_name = "Ep2(MaxPool)";
                    break;
                case 2: // Epoch 3 結束 (Gemm)
                    inspect_addr = 0x342E1080; // offset 4224 (0x1080)
                    step_name = "Ep3(Gemm1)  ";
                    break;
                case 3: // Epoch 4 結束 (Gemm)
                    inspect_addr = 0x342E0000; // offset 0
                    step_name = "Ep4(Gemm2)  ";
                    break;
                case 4: // Epoch 5 結束 (Gemm -> Logits)
                    inspect_addr = 0x342E0100; // offset 256
                    step_name = "Ep5(Logits) ";
                    break;
                case 5: // Epoch 6 結束 (Softmax)
                    inspect_addr = 0x342E0110; // offset 272
                    step_name = "Ep6(Softmax)";
                    break;
                default:
                    inspect_addr = 0;
            }

            if (inspect_addr != 0) {
                // 刷新 Cache 確保讀到最新值
                mcu_cache_clean_invalidate_range(inspect_addr, 32);
                uint8_t *p_data = (uint8_t *)inspect_addr;

                printf("   [%s Output] @0x%08X: ", step_name, (unsigned int)inspect_addr);
                for(int k=0; k<10; k++) { // 印前10個 Byte
                    printf("%02X ", p_data[k]);
                }
                printf("\r\n");
            }
            /* ================================= */

        } while (ll_aton_rt_ret != LL_ATON_RT_DONE);

        /* --- Step E: 最終結果檢查 --- */
        if (ll_aton_rt_ret != LL_ATON_RT_DONE) {
            printf("Error: Inference failed, ret=%d\r\n", (int)ll_aton_rt_ret);
            continue;
        }

        // 讀取 Softmax 前的原始值 (Raw Logits)
        mcu_cache_clean_invalidate_range(raw_logits_addr, 32);
        int8_t *p_raw = (int8_t *)raw_logits_addr;

        // 讀取 Softmax 後的機率
        mcu_cache_clean_invalidate_range((uint32_t)buffer_out, (uint32_t)buff_out_len);
        int8_t raw_normal = (int8_t)buffer_out[0];
        int8_t raw_abnormal = (int8_t)buffer_out[1];

        // 顯示
        printf("   [Final Check]\r\n");
        printf("   ├── Raw Logits: [%d, %d]\r\n", p_raw[0], p_raw[1]);
        printf("   └── Final Prob: [%d, %d] -> ", raw_normal, raw_abnormal);

        if (raw_normal > raw_abnormal) {
            printf("Predict: NORMAL\r\n");
        } else {
            printf("Predict: ABNORMAL\r\n");
        }

        printf("--------------------------------------------------\r\n");

        LL_ATON_RT_DeInit_Network(&NN_Instance_Default);
    }

    LL_ATON_RT_RuntimeDeInit();
    /* USER CODE END 6 */
}
//void MX_X_CUBE_AI_Process(void)
//{
//    /* USER CODE BEGIN 6 */
//
//    /* ============================================================= */
//    /* 1. 變數宣告區 (全部移到最上面，避免 Scope 編譯錯誤)             */
//    /* ============================================================= */
//    LL_ATON_RT_RetValues_t ll_aton_rt_ret = LL_ATON_RT_DONE;
//
//    // 緩衝區資訊
//    const LL_Buffer_InfoTypeDef * ibuffersInfos;
//    const LL_Buffer_InfoTypeDef * obuffersInfos;
//
//    // 除錯用的地址 (根據 network.c 分析)
//    uint32_t sram5_addr      = 0x342E0000; // Activation Buffer 起始
//    uint32_t raw_logits_addr = 0x342E0100; // Softmax 前的原始值 (Epoch 5 Output)
//    uint32_t final_prob_addr = 0x342E0110; // Softmax 後的最終值 (Epoch 6 Output)
//
//    // 迴圈與計數變數
//    int i, j;
//
//    /* ============================================================= */
//    /* 2. 系統初始化與問路                                           */
//    /* ============================================================= */
//
//    /* 取得緩衝區說明書 */
//    ibuffersInfos = NN_Interface_Default.input_buffers_info();
//    obuffersInfos = NN_Interface_Default.output_buffers_info();
//
//    /* 算出實際記憶體地址 */
//    buffer_in  = (uint8_t *)LL_Buffer_addr_start(&ibuffersInfos[0]);
//    buffer_out = (uint8_t *)LL_Buffer_addr_start(&obuffersInfos[0]);
//
//    /* 計算並印出長度 */
//    buff_in_len = ibuffersInfos->offset_end - ibuffersInfos->offset_start;
//    buff_out_len = obuffersInfos->offset_end - obuffersInfos->offset_start;
//
//    printf("Debug: Input Size = %lu (Expected: 250)\n\r", buff_in_len);
//    printf("Debug: Output Size = %lu (Expected: 2)\n\r", buff_out_len);
//
//    /* 初始化隨機亂數種子 */
//    static uint8_t srand_init = 0;
//    if (!srand_init) {
//        srand(HAL_GetTick());
//        srand_init = 1;
//    }
//
//    /* AI Runtime 初始化 */
//    LL_ATON_RT_RuntimeInit();
//
//    /* 印出 Security 狀態 (SAU/TrustZone) */
//    Print_Security_Debug();
//
//    printf("\r\n=============================================\r\n");
//    printf("   STM32 NPU Debug Mode: Full Diagnostics    \r\n");
//    printf("=============================================\r\n");
//
//    /* ============================================================= */
//    /* 3. 硬體完整性檢查 (只做一次)                                  */
//    /* ============================================================= */
//
//    /* [Test 1] 檢查 Flash 權重區是否可讀 */
//    uint8_t *flash_addr = (uint8_t *)0x71000000;
//    printf("[Test 1] Checking Weight Flash at 0x71000000...\r\n");
//    printf("   Data: ");
//    for(i=0; i<8; i++) {
//        printf("%02X ", flash_addr[i]);
//    }
//    printf("\r\n");
//
//    /* ============================================================= */
//    /* 4. 推論迴圈 (使用混合測試集)                                  */
//    /* ============================================================= */
//
//    // 使用 TEST_DATA_LEN (Python生成的總筆數)
//    for (i = 0; i < TEST_DATA_LEN; i++) {
//
//        printf("\r\n--- [Sample #%d] ---\r\n", i);
//
//        /* ------------------------------------------------- */
//        /* Step A: 準備輸入數據                              */
//        /* ------------------------------------------------- */
//        const int8_t *p_source_data = TEST_DATA_MIXED[i]; // 從 header 檔拿資料
//
//        // 填入 Input Buffer (SRAM)
//        for(uint32_t idx = 0; idx < buff_in_len; idx++){
//            buffer_in[idx] = (uint8_t)p_source_data[idx];
//            printf("E:%d\r\n", (int8_t)p_source_data[idx]);  /* cast回int8打印 */
//        }
//
//        // 印出前 10 筆確認
//        printf("LED0 (Input Data Check)\n\r");
//        printf("Buffer[0~9] = %d,%d,%d,%d,%d,%d,%d,%d,%d,%d \n\r",
//                (int8_t)buffer_in[0], (int8_t)buffer_in[1], (int8_t)buffer_in[2],
//                (int8_t)buffer_in[3], (int8_t)buffer_in[4], (int8_t)buffer_in[5],
//                (int8_t)buffer_in[6], (int8_t)buffer_in[7], (int8_t)buffer_in[8],
//                (int8_t)buffer_in[9]);
//
//        /* ------------------------------------------------- */
//        /* Step B: 關鍵除錯 - 預填垃圾數據 (0x55)             */
//        /* ------------------------------------------------- */
//        // 在 NPU 跑之前，先把它的輸出目的地填爛，確保它是真的有寫入
//        memset((void*)raw_logits_addr, 0x55, 32);
//        mcu_cache_clean_invalidate_range(raw_logits_addr, 32); // 寫入實體 RAM
//
//        /* ------------------------------------------------- */
//        /* Step C: Cache 維護 (CPU -> RAM)                   */
//        /* ------------------------------------------------- */
//        // 確保輸入數據寫入 RAM，NPU 才讀得到
//        mcu_cache_clean_invalidate_range((uint32_t)buffer_in, (uint32_t)buff_in_len);
//        npu_cache_invalidate(); // 通知 NPU 緩存失效
//
//        /* ------------------------------------------------- */
//        /* Step D: 執行推論 (Inference)                      */
//        /* ------------------------------------------------- */
//        printf("LED1 (Start Inference)\n\r");
//        LL_ATON_RT_Init_Network(&NN_Instance_Default);
//
//        printf("LED2 (Running Epochs)\n\r");
//        do {
//            ll_aton_rt_ret = LL_ATON_RT_RunEpochBlock(&NN_Instance_Default);
//            if (ll_aton_rt_ret == LL_ATON_RT_WFE) {
//                LL_ATON_OSAL_WFE();
//            }
//        } while (ll_aton_rt_ret != LL_ATON_RT_DONE);
//
//        printf("LED3 (Inference End)\n\r");
//
//        /* ------------------------------------------------- */
//        /* Step E: 錯誤檢查與詳細診斷                        */
//        /* ------------------------------------------------- */
//
//        if (ll_aton_rt_ret != LL_ATON_RT_DONE) {
//            printf("Error: Inference failed, ret=%d\r\n", (int)ll_aton_rt_ret);
//            continue; // 跳過這筆
//        }
//
//        /* 診斷 1: 檢查 Raw Logits 是否被 NPU 寫入 (檢查 0x55) */
//        mcu_cache_clean_invalidate_range(raw_logits_addr, 32); // 讀回最新值
//        int8_t *p_raw = (int8_t *)raw_logits_addr;
//        int8_t *p_final = (int8_t *)final_prob_addr; // 這個是 Softmax 後的結果
//
//        printf("   [Debug Analysis - Softmax Saturation Check]\r\n");
//        if (p_raw[0] == 0x55 && p_raw[1] == 0x55) {
//            printf("   ❌ FATAL: Memory is still 0x55! NPU did NOT write to output.\r\n");
//        } else {
//            printf("   ├── Raw Logits (NPU Output): [%d, %d]\r\n", p_raw[0], p_raw[1]);
//            printf("   └── Final Prob (SW Softmax): [%d, %d]\r\n", p_final[0], p_final[1]);
//
//            int diff = p_raw[0] - p_raw[1];
//            if (diff == 0) {
//                 printf("   ⚠️ ALERT: Raw Logits Identical (Model Brain Dead?)\r\n");
//            } else if (p_final[0] == 127 || p_final[1] == 127) {
//                 printf("   ℹ️ NOTE: Softmax Saturated. (Raw Diff %d -> 100%%/0%%)\r\n", diff);
//            }
//        }
//
//        /* 診斷 2: 檢查 Activation Buffer (SRAM5) 是否有動靜 */
//        printf("   [Debug Analysis - SRAM5 Activity Check]\r\n");
//        mcu_cache_clean_invalidate_range(sram5_addr, 1024); // 刷新
//        uint8_t *p_mem = (uint8_t *)sram5_addr;
//        int non_zero_count = 0;
//
//        printf("   [Memory Dump @ 0x%08X]:\r\n   ", (unsigned int)sram5_addr);
//        for(int k=0; k<64; k++) {
//            printf("%02X ", p_mem[k]);
//            if(p_mem[k] != 0) non_zero_count++;
//            if((k+1)%16==0) printf("\r\n   ");
//        }
//        printf("\r\n");
//
//        if(non_zero_count == 0) {
//            printf("   ⚠️ WARNING: Memory is ALL ZERO! (NPU didn't write anything)\r\n");
//        } else {
//            printf("   ✅ OK: Non-zero content found! NPU is working.\r\n");
//        }
//
//        /* ------------------------------------------------- */
//        /* Step F: 輸出最終結果                              */
//        /* ------------------------------------------------- */
//
//        // 處理 Output Cache
//        mcu_cache_clean_invalidate_range((uint32_t)buffer_out, (uint32_t)buff_out_len);
//
//        int8_t raw_normal = (int8_t)buffer_out[0];
//        int8_t raw_abnormal = (int8_t)buffer_out[1];
//
//        // 顯示機率
//        float prob_normal = ((float)raw_normal + 128.0f) / 255.0f * 100.0f;
//        float prob_abnormal = ((float)raw_abnormal + 128.0f) / 255.0f * 100.0f;
//
//        printf("Raw: [%d, %d] -> Prob: [%d%%, %d%%]\r\n",
//                raw_normal, raw_abnormal, (int)prob_normal, (int)prob_abnormal);
//
//        if (raw_normal > raw_abnormal) {
//            printf(">>> Prediction: NORMAL (正常)\r\n");
//        } else {
//            printf(">>> Prediction: ABNORMAL (異常)\r\n");
//        }
//
//        printf("--------------------------------------------------\r\n");
//
//        LL_ATON_RT_DeInit_Network(&NN_Instance_Default);
//    }
//
//    LL_ATON_RT_RuntimeDeInit();
//    /* USER CODE END 6 */
//}


#ifdef __cplusplus
}
#endif
